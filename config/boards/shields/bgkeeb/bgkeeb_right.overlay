#include "bgkeeb.dtsi" // Notice that the main dtsi files are included in the overlay.

// Sin col-offset: el keymap bgkeeb.keymap es compartido de 5 cols y cada mitad
// mapea sus 5 columnas físicas a las mismas 5 posiciones del keymap.

&kscan0 {
    // #define MATRIX_ROW_PINS { F6, D7, B3, E6 }     == { 19, 6, 14, 7 }
    // #define MATRIX_COL_PINS { F4, D4, F5, B1, B2 } == { 21, 4, 20, 15, 16 }
    // columns reversed
    col-gpios
        = <&pro_micro 16 (GPIO_ACTIVE_HIGH | GPIO_PULL_DOWN)> // col1 in the schematic
        , <&pro_micro 15 (GPIO_ACTIVE_HIGH | GPIO_PULL_DOWN)>  // col2 in the schematic
        , <&pro_micro 20 (GPIO_ACTIVE_HIGH | GPIO_PULL_DOWN)> // col3 in the schematic
        , <&pro_micro 4  (GPIO_ACTIVE_HIGH | GPIO_PULL_DOWN)> // col4 in the schematic
        , <&pro_micro 21 (GPIO_ACTIVE_HIGH | GPIO_PULL_DOWN)> // col5 in the schematic
        ;
};